## app/modules/led_sensor/drivers/led_sensor/Kconfig
```kconfig
# SPDX-License-Identifier: Apache-2.0

menuconfig LED_SENSOR
  bool "LED sensor driver"
  default y
  depends on DT_HAS_ZEPHYR_LED_SENSOR_ENABLED
  select GPIO
  select SENSOR
  help
    Enable the sensor driver backed by an on-board LED.
```

## app/modules/led_sensor/dts/bindings/sensor/demo,led-sensor.yaml
```yaml
description: LED-backed demo sensor

compatible: "demo,led-sensor"

properties:
  gpios:
    type: phandle-array
    required: true
```

## app/modules/led_sensor/dts/bindings/sensor/mert,led-sensor.yaml
```yaml
description: LED-backed demo sensor

compatible: "mert,led-sensor"

properties:
  gpios:
    type: phandle-array
    required: true
```

## app/modules/led_sensor/dts/bindings/sensor/zephyr,led-sensor.yaml
```yaml
description: LED-backed demo sensor

compatible: "zephyr,led-sensor"

properties:
  gpios:
    type: phandle-array
    required: true
```

## boards/arm/nucleo_h723zg_custom/board.yml
```yaml
board:
  name: nucleo_h723zg_custom
  full_name: Custom Nucleo H723ZG
  vendor: st
  socs:
    - name: stm32h723xx
```

## boards/arm/nucleo_h723zg_scratch/Kconfig.defconfig
```kconfig
# SPDX-License-Identifier: Apache-2.0

if BOARD_NUCLEO_H723ZG_SCRATCH

config ARM_MPU
	default y

config HW_STACK_PROTECTION
	default y

config SERIAL
	default y

config CONSOLE
	default y

config UART_CONSOLE
	default y

config GPIO
	default y

endif
```

## boards/arm/nucleo_h723zg_scratch/Kconfig.nucleo_h723zg_scratch
```kconfig
# SPDX-License-Identifier: Apache-2.0

config BOARD_NUCLEO_H723ZG_SCRATCH
	select SOC_STM32H723XX
```

## boards/arm/nucleo_h723zg_scratch/board.yml
```yaml
board:
  name: nucleo_h723zg_scratch
  full_name: Scratch Nucleo H723ZG
  vendor: st
  socs:
    - name: stm32h723xx
```
